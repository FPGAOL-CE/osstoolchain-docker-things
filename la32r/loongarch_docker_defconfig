## la32r/loongarch_docker_defconfig
```kconfig
BR2_loongisa=y
BR2_LISA_32=y
BR2_TOOLCHAIN_EXTERNAL=y
BR2_TOOLCHAIN_EXTERNAL_PATH="/opt/la32r"
BR2_TOOLCHAIN_EXTERNAL_CUSTOM_PREFIX="loongarch32r-linux-gnusf"
BR2_TOOLCHAIN_EXTERNAL_GCC_8=y
BR2_TOOLCHAIN_EXTERNAL_HEADERS_5_14=y
BR2_TOOLCHAIN_EXTERNAL_CUSTOM_GLIBC=y
BR2_SHARED_STATIC_LIBS=y
BR2_INIT_SYSTEMD=y
BR2_TARGET_GENERIC_ROOT_PASSWD="loongson"
BR2_LINUX_KERNEL=y
BR2_LINUX_KERNEL_CUSTOM_TARBALL=y
BR2_LINUX_KERNEL_CUSTOM_TARBALL_LOCATION="file:///src/la32r-Linux.tar.gz"
BR2_LINUX_KERNEL_DEFCONFIG="la32"
BR2_PACKAGE_BZIP2=y
BR2_PACKAGE_GZIP=y
BR2_PACKAGE_UNZIP=y
BR2_PACKAGE_ZIP=y
BR2_PACKAGE_CPIO=y
BR2_PACKAGE_E2FSPROGS=y
BR2_PACKAGE_E2FSPROGS_DEBUGFS=y
BR2_PACKAGE_EXFAT_UTILS=y
BR2_PACKAGE_NFS_UTILS=y
BR2_PACKAGE_NTFS_3G=y
BR2_PACKAGE_PARTED=y
BR2_PACKAGE_LIBAIO=y
BR2_PACKAGE_LIBCAP_TOOLS=y
BR2_PACKAGE_LIBCAP_NG=y
BR2_PACKAGE_INIH=y
BR2_PACKAGE_NCURSES=y
BR2_PACKAGE_IPROUTE2=y
BR2_PACKAGE_LOGROTATE=y
BR2_PACKAGE_NUMACTL=y
BR2_PACKAGE_SYSTEMD_QUOTACHECK=y
BR2_PACKAGE_UTIL_LINUX_UNSHARE=y
BR2_TARGET_ROOTFS_CPIO_GZIP=y
BR2_TARGET_ROOTFS_EXT2=y
BR2_TARGET_ROOTFS_EXT2_4=y
BR2_TARGET_ROOTFS_EXT2_SIZE="1024M"
BR2_TARGET_ROOTFS_INITRAMFS=y
```
